// generated by mBlock5 for <your product>
// codes make you happy

#include <Arduino.h>
#include <Wire.h>
#include <SoftwareSerial.h>

float ver = 1;
float velocidad = 60;

float ENA = 6;
float ENB = 3;

float IN1 = 8;
float IN2 = 10;
float IN3 = 11;
float IN4 = 12;

float SensorDerecho = 4;
float SensorIzquierdo = 5;
float no_ver = 0;
float SensorDerechoValor = 0;
float SensorIzquierdoValor = 0;

void Sensor_Derecho(){
  if(digitalRead(SensorDerecho)){
    SensorDerechoValor = ver;

  }else{
    SensorDerechoValor = no_ver;

  }

}
void Sensor_Izquierdo(){
  if(digitalRead(SensorIzquierdo)){
    SensorIzquierdoValor = ver;

  }else{
    SensorIzquierdoValor = no_ver;

  }

}
void robot_detiene(){
  analogWrite(ENA,0);
  analogWrite(ENB,0);

}

void robot_adelante(){
  analogWrite(ENA,velocidad+30);
  digitalWrite(IN1,HIGH);
  digitalWrite(IN2,0);
  analogWrite(ENB,velocidad+30);
  digitalWrite(IN3,HIGH);
  digitalWrite(IN4,0);

}

void robot_derecha(){
  analogWrite(ENA,velocidad-10);
  digitalWrite(IN1,HIGH);
  digitalWrite(IN2,0);
  analogWrite(ENB,0);
  digitalWrite(IN3,0);
  digitalWrite(IN4,HIGH);

}
void robot_izquierda(){
  analogWrite(ENA,0);
  digitalWrite(IN1,0);
  digitalWrite(IN2,HIGH);
  analogWrite(ENB,velocidad-5);
  digitalWrite(IN3,HIGH);
  digitalWrite(IN4,0);

}

void _delay(float seconds) {
  long endTime = millis() + seconds * 1000;
  while(millis() < endTime) _loop();
}

void setup() {
  Serial.begin(9600);
  pinMode(SensorDerecho,INPUT);
  pinMode(SensorIzquierdo,INPUT);
  pinMode(ENA,OUTPUT);
  pinMode(IN1,OUTPUT);
  pinMode(IN2,OUTPUT);
  pinMode(ENB,OUTPUT);
  pinMode(IN3,OUTPUT);
  pinMode(IN4,OUTPUT);
  // El robot puede ver la linea negra cuando recibe un valor de 1 del sensor
  ver = 1;
  // El robot no ve la linea negra cuando recibe un valor de 0
  no_ver = 0;
  SensorDerechoValor = 0;
  SensorIzquierdoValor = 0;
 
  // Repetir las decisiones de movimiento del robot PARA SIEMPRE
  while(1) {
      Sensor_Derecho();
      Sensor_Izquierdo();
      //Serial.println(SensorDerechoValor);

      // SI el sensor derecho pueder y el sensor
      // izquierdo puede ver, ENTONCES el robot avanza
      if((SensorDerechoValor == ver)  &&  (SensorIzquierdoValor == ver)){
        robot_adelante();
        // Serial.println("Avanza");

      }
      // SI el sensor derecho NO puede ver y el sensor
      // izquierdo NO puede ver, ENTONCES el robot se detiene
      if((!((SensorDerechoValor == ver)))  &&  (!((SensorIzquierdoValor == ver)))){
        //robot_detiene();

      }
      // SI el sensor derecho puede ver y el sensor izquierdo
      // NO puede ver, ENTONCES mueve el robot a la derecha
      if((SensorDerechoValor == ver)  &&  (!((SensorIzquierdoValor == ver)))){
        robot_izquierda();

      }
      // SI el sensor derecho NO puede ver y el sensor izquierdo
      // puede ver, ENTONCES mueve el robot a la izquierda
      if((!((SensorDerechoValor == ver)))  &&  (SensorIzquierdoValor == ver)){
        robot_derecha();

      }

      _loop();
  }

}

void _loop() {
}

void loop() {
  _loop();
}
